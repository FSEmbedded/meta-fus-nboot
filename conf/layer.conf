## conf/layer.conf
```bitbake
# We have a conf and classes directory, add to BBPATH
BBPATH .= ":${LAYERDIR}"

# We have recipes-* directories, add to BBFILES
BBFILES += "${LAYERDIR}/recipes-*/*/*.bb \
            ${LAYERDIR}/recipes-*/*/*.bbappend"

BBFILE_COLLECTIONS += "fus-nboot"
BBFILE_PATTERN_fus-nboot = "^${LAYERDIR}/"
BBFILE_PRIORITY_fus-nboot = "10"
LAYERVERSION_fus-nboot = "1"
LAYERSERIES_COMPAT_fus-nboot = "scarthgap"

#NBOOT settings
NBOOT_MAKE_TARGET = "nboot"

# Get rid of warnings
PREFERRED_VERSION_optee-os:fsimx8mp  = ""
PREFERRED_VERSION_optee-os:fsimx8mm  = ""
PREFERRED_VERSION_optee-os:fsimx8mn  = ""
#FSIMX93
REQUIRED_VERSION_firmware-ele-imx:fsimx93 = "2.0.2.1"
REQUIRED_VERSION_imx-boot-firmware-files:fsimx93 = "8.27"

#FSIMX8ULP
REQUIRED_VERSION_firmware-ele-imx:fsimx8ulp = "2.0.2.1"
REQUIRED_VERSION_firmware-upower:fsimx8ulp = "1.3.1"
PREQUIRED_VERSION_imx-boot-firmware-files:fsimx8ulp = "8.26.1"

MACHINE_ESSENTIAL_EXTRA_RRECOMMENDS:fsimx8ulp:append = " nboot m33-image"
M33_IMAGE:fsimx8ulp ??= "realtimed"

#FSIMX8MP
REQUIRED_VERSION_imx-boot-firmware-files:fsimx8mp = "8.26.1"
REQUIRED_VERSION_imx-atf:fsimx8mp = "2.10+git"
REQUIRED_VERSION_optee-os:fsimx8mp = "4.4.0.imx"
DDR_FIRMWARE_VERSION:fsimx8mp = "202006"
DDR_FIRMWARE_NAME:fsimx8mp = " \
    lpddr4_pmu_train_1d_imem_${DDR_FIRMWARE_VERSION}.bin \
	lpddr4_pmu_train_1d_dmem_${DDR_FIRMWARE_VERSION}.bin \
	lpddr4_pmu_train_2d_imem_${DDR_FIRMWARE_VERSION}.bin \
	lpddr4_pmu_train_2d_dmem_${DDR_FIRMWARE_VERSION}.bin \
    ddr4_imem_1d_${DDR_FIRMWARE_VERSION}.bin \
    ddr4_dmem_1d_${DDR_FIRMWARE_VERSION}.bin \
	ddr4_imem_2d_${DDR_FIRMWARE_VERSION}.bin \
    ddr4_dmem_2d_${DDR_FIRMWARE_VERSION}.bin \
"

#FSIMX8MM
REQUIRED_VERSION__imx-boot-firmware-files:fsimx8mm = "8.26.1"
REQUIRED_VERSION_imx-atf:fsimx8mm = "v2.10-fus1.4"
REQUIRED_VERSION_optee-os:fsimx8mm = "4.4.0.imx"
DDR_FIRMWARE_NAME:fsimx8mm = " \
    lpddr4_pmu_train_1d_imem.bin \
    lpddr4_pmu_train_1d_dmem.bin \
	lpddr4_pmu_train_2d_imem.bin \
    lpddr4_pmu_train_2d_dmem.bin \
    ddr4_imem_1d.bin \
    ddr4_dmem_1d.bin \
	ddr4_imem_2d.bin \
    ddr4_dmem_2d.bin \
    ddr3_imem_1d.bin \
    ddr3_dmem_1d.bin \
"

#FSIMX8MN
REQUIRED_VERSION_imx-boot-firmware-files:fsimx8mn = "8.26.1"
REQUIRED_VERSION_imx-atf:fsimx8mn = "2.10+git"
REQUIRED_VERSION_optee-os:fsimx8mn = "4.4.0.imx"
DDR_FIRMWARE_NAME:fsimx8mn = " \
    lpddr4_pmu_train_1d_imem.bin \
    lpddr4_pmu_train_1d_dmem.bin \
	lpddr4_pmu_train_2d_imem.bin \
    lpddr4_pmu_train_2d_dmem.bin \
    ddr4_imem_1d.bin \
    ddr4_dmem_1d.bin \
	ddr4_imem_2d.bin \
    ddr4_dmem_2d.bin \
    ddr3_imem_1d_201810.bin \
    ddr3_dmem_1d_201810.bin \
"
```
